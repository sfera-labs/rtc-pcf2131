/dts-v1/;
/plugin/;

/ {
	compatible = "brcm,bcm2835";
	
	fragment@0 {
		target = <&i2c_arm>;
		__overlay__ {
			#address-cells = <1>;
			#size-cells = <0>;
			status = "okay";
			
			pcf2131: pcf2131@53 {
				compatible = "sferalabs,rtc-pcf2131";
				reg = <0x53>;
				status = "okay";
			};
		};
	};
};
